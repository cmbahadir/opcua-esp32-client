## main/Kconfig.projbuild
```kconfig
menu "Connection Configuration"

config WIFI_SSID
	string "WiFi SSID"
	default "OPCUATaskForce"
	help
		Network Name

config WIFI_PASSWORD
	string "WiFi Password"
	default "OPCUApubsub"
	help
		WiFi Password (WPA or WPA2)

config OPC_SERVER_IP
	string "OPC UA Server IP"
	default "opc.tcp://192.168.2.243:4840"
	help
		OPC UA Server IP
		
endmenu
```
